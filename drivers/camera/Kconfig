## drivers/camera/Kconfig
```kconfig
#
# Spreadtrum camera BSP drivers
#

menu "Spreadtrum camera drivers"

config SPRD_CAMERA_CORE
	tristate "Spreadtrum camera core driver"
	depends on SPRD_CAMERA_FLASH_DRV
	depends on SPRD_CAMERA_SENSOR
	default n
	help
	  Say Y here if your device support Spreadtrum camera core driver.

	  To compile this driver as a module, choose M here.

config SPRD_CAMERA_CPP
	tristate "Spreadtrum camera cpp driver"
	default n
	help
	  Say Y here if your device support Spreadtrum camera cpp driver.

	  To compile this driver as a module, choose M here.

config SPRD_CAMERA_FD
	tristate "Spreadtrum camera fd driver"
	default n
	help
	  Say Y here if your device support Spreadtrum camera fd driver.

	  To compile this driver as a module, choose M here.

config SPRD_CAMERA_FLASH
	tristate "Spreadtrum camera flash drivers"
	default n
	help
	  Say Y here if your device support Spreadtrum camera flash drivers.

	  To compile thoses drivers as modules, choose M here.

config SPRD_CAMERA_FLASH_DRV
	tristate "Spreadtrum camera flash DRV driver"
	depends on SPRD_CAMERA_FLASH
	default n
	help
	  Say Y here if your device support Spreadtrum camera flash DRV driver.

	  To compile this driver as a module, choose M here.

config SPRD_CAMERA_FLASH_OCP8137
	tristate "Spreadtrum camera flash ocp8137 driver"
	depends on SPRD_CAMERA_FLASH
	default n
	help
	  Say Y here if your device support Spreadtrum camera flash ocp8137 driver.

	  To compile this driver as a module, choose M here.

config SPRD_CAMERA_MMDVFS
	tristate "Spreadtrum camera mmdvfs driver"
	default n
	help
	  Say Y here if your device support Spreadtrum camera mmdvfs driver.

	  To compile this driver as a module, choose M here.

config SPRD_CAMERA_SENSOR
	tristate "Spreadtrum camera sensor driver"
	default n
	help
	  Say Y here if your device support Spreadtrum camera sensor driver.

	  To compile this driver as a module, choose M here.

endmenu
```

## drivers/npu/Kconfig
```kconfig
#
# Spreadtrum NPU BSP drivers
#

menu "Spreadtrum Neural Process Unit (NPU) drivers"

config NPU_VDSP
	tristate "Spreadtrum NPU VDSP driver"
	default n
	help
	  Say Y here if your device support Spreadtrum NPU VDSP driver.

	  To compile this driver as a module, choose M here.

endmenu
```

## drivers/soc/oplus/Kconfig
```kconfig
config OPLUS_DEVICE_IFNO
        bool "config oplus devinfo"
        help
        define this config to compile devinfo.c for device register.

source "drivers/soc/oplus/oplus_devinfo/Kconfig"
```

## drivers/wcn/Kconfig
```kconfig
#
# Spreadtrum WCN BSP drivers
#

menu "Spreadtrum Wireless Connectivity (WCN) drivers"

config WCN_BLUETOOTH
	tristate "Spreadtrum WCN bluetooth driver"
	default n
	help
	  Say Y here if your device support Spreadtrum WCN BSP bluetooth driver.

	  To compile this driver as a module, choose M here.

config WCN_FM
	tristate "Spreadtrum WCN FM driver"
	default n
	help
	  Say Y here if your device support Spreadtrum WCN BSP FM driver.

	  To compile this driver as a module, choose M here.

config WCN_WLAN
	tristate "Spreadtrum WCN wlan driver"
	default n
	help
	  Say Y here if your device support Spreadtrum WCN BSP wlan driver.

	  To compile this driver as a module, choose M here.

config WCN_WLAN_DEBUG
	bool "Spreadtrum WCN wlan debugging"
	depends on WCN_WLAN
	default y
	help
	  Say Y here if you want to enable Spreadtrum WCN BSP wlan debugging.

	  If unsure, say N.

endmenu
```
